/* Формат выходного файла - 32-битный (i386) */
OUTPUT_FORMAT(elf32-i386)

/* 
 * Точка входа программы - символ 'start' 
 * Это первая инструкция, которая будет выполнена при загрузке программы
 */
ENTRY(start)

SECTIONS
{
    /* 
     * Устанавливаем текущий адрес размещения на 1MB (0x100000)
     */
    . = 0x100000;
    
    /* Символ начала ядра */
    _kernel_start = .;
    
    .text : { *(.text) }
    .data : { *(.data) }
    .bss  : { *(.bss)  }
    
    /* Символ конца ядра */
    _kernel_end = .;
}